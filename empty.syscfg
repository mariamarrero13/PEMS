// These arguments were used when this file was generated. They will be automatically applied on subsequent loads 
// via the GUI or CLI invocations. Run CLI with '--help' for additional information on how to override these arguments.
// @cliArgs --board "/ti/boards/CC3220S_LAUNCHXL" --product "simplelink_cc32xx_sdk@3.30.01.02"
// @versions {"data":"2019083011","timestamp":"2019083011","tool":"1.2.952","templates":"2019083011"}

var RTOS = scripting.addModule("/ti/drivers/RTOS");
var GPIO = scripting.addModule("/ti/drivers/GPIO");
var Power = scripting.addModule("/ti/drivers/Power");
var Board = scripting.addModule("/ti/drivers/Board");
var DriverLib = scripting.addModule("/ti/devices/DriverLib");
var GPIO1 = GPIO.addInstance();
var GPIO2 = GPIO.addInstance();
var GPIO3 = GPIO.addInstance();
var GPIO4 = GPIO.addInstance();
var GPIO5 = GPIO.addInstance();
var GPIO6 = GPIO.addInstance();
var GPIO7 = GPIO.addInstance();
var GPIO8 = GPIO.addInstance();
var GPIO9 = GPIO.addInstance();
var GPIO10 = GPIO.addInstance();
var GPIO11 = GPIO.addInstance();
var PWM = scripting.addModule("/ti/drivers/PWM");
var PWM1 = PWM.addInstance();
var UART = scripting.addModule("/ti/drivers/UART");
var UART1 = UART.addInstance();
var Timer = scripting.addModule("/ti/drivers/Timer");
var Timer1 = Timer.addInstance();
var Timer2 = Timer.addInstance();
var Capture = scripting.addModule("/ti/drivers/Capture");
var Capture1 = Capture.addInstance();
var GPIO12 = GPIO.addInstance();
var SimpleLinkWifi = scripting.addModule("/ti/drivers/net/wifi/SimpleLinkWifi");
var Crypto = scripting.addModule("/ti/drivers/Crypto");
var Crypto1 = Crypto.addInstance();
var DMA = scripting.addModule("/ti/drivers/DMA");
var SPI = scripting.addModule("/ti/drivers/SPI");
// IO Retention Shutdown - IO groups to be retained during Shutdown
Power.ioRetentionShutdown = ["GRP_1"];
// Name
Power.parkPins.$name = "ti_drivers_power_PowerCC32XXPins0";
// Name - The C/C++ identifier used in applications as the index parameter passed to GPIO runtime APIs
GPIO1.$name = "D_7";
// Mode - Select the GPIO mode
GPIO1.mode = "Output";
// Output Strength - Specifies the output strength
GPIO1.outputStrength = "Low";
// Assign pin
GPIO1.gpioPin.$assign = "boosterpack.27"; // P63
// Name - The C/C++ identifier used in applications as the index parameter passed to GPIO runtime APIs
GPIO2.$name = "D_6";
// Mode - Select the GPIO mode
GPIO2.mode = "Output";
// Output Strength - Specifies the output strength
GPIO2.outputStrength = "Low";
// Assign pin
GPIO2.gpioPin.$assign = "boosterpack.28"; // P53
// Name - The C/C++ identifier used in applications as the index parameter passed to GPIO runtime APIs
GPIO3.$name = "D_5";
// Mode - Select the GPIO mode
GPIO3.mode = "Output";
// Output Strength - Specifies the output strength
GPIO3.outputStrength = "Low";
// Assign pin
GPIO3.gpioPin.$assign = "boosterpack.29"; // P64
// Name - The C/C++ identifier used in applications as the index parameter passed to GPIO runtime APIs
GPIO4.$name = "D_4";
// Mode - Select the GPIO mode
GPIO4.mode = "Output";
// Output Strength - Specifies the output strength
GPIO4.outputStrength = "Low";
// Assign pin
GPIO4.gpioPin.$assign = "boosterpack.30"; // P50
// Name - The C/C++ identifier used in applications as the index parameter passed to GPIO runtime APIs
GPIO5.$name = "LCD_E";
// Mode - Select the GPIO mode
GPIO5.mode = "Output";
// Output Strength - Specifies the output strength
GPIO5.outputStrength = "Low";
// Assign pin
GPIO5.gpioPin.$assign = "boosterpack.19"; // P18
// Name - The C/C++ identifier used in applications as the index parameter passed to GPIO runtime APIs
GPIO6.$name = "LCD_Rs";
// Mode - Select the GPIO mode
GPIO6.mode = "Output";
// Output Strength - Specifies the output strength
GPIO6.outputStrength = "Low";
// Assign pin
GPIO6.gpioPin.$assign = "boosterpack.10"; // P02
// Name - The C/C++ identifier used in applications as the index parameter passed to GPIO runtime APIs
GPIO7.$name = "Relay1";
// Mode - Select the GPIO mode
GPIO7.mode = "Output";
// Output Strength - Specifies the output strength
GPIO7.outputStrength = "Low";
// Assign pin
GPIO7.gpioPin.$assign = "boosterpack.3"; // P04
// Name - The C/C++ identifier used in applications as the index parameter passed to GPIO runtime APIs
GPIO8.$name = "Relay2";
// Mode - Select the GPIO mode
GPIO8.mode = "Output";
// Output Strength - Specifies the output strength
GPIO8.outputStrength = "Low";
// Assign pin
GPIO8.gpioPin.$assign = "boosterpack.8"; // P62
// Name - The C/C++ identifier used in applications as the index parameter passed to GPIO runtime APIs
GPIO9.$name = "UP";
// Callback Function - The name of the callback function called when this GPIO pin triggers an interrupt, or 'NULL' if it's specified at runtime
GPIO9.callbackFunction = "";
// Output Strength - Specifies the output strength
GPIO9.outputStrength = "Low";
// Assign pin
GPIO9.gpioPin.$assign = "boosterpack.14"; // P06
// Name - The C/C++ identifier used in applications as the index parameter passed to GPIO runtime APIs
GPIO10.$name = "DOWN";
// Callback Function - The name of the callback function called when this GPIO pin triggers an interrupt, or 'NULL' if it's specified at runtime
GPIO10.callbackFunction = "";
// Assign pin
GPIO10.gpioPin.$assign = "boosterpack.5"; // P61
// Name - The C/C++ identifier used in applications as the index parameter passed to GPIO runtime APIs
GPIO11.$name = "ENTER";
// Callback Function - The name of the callback function called when this GPIO pin triggers an interrupt, or 'NULL' if it's specified at runtime
GPIO11.callbackFunction = "";
// Assign pin
GPIO11.gpioPin.$assign = "boosterpack.11"; // P15
// Name - The C/C++ identifier used in applications as the index parameter passed to PWM runtime APIs
PWM1.$name = "CONFIG_PWM_0";
// Name
PWM1.timer.$name = "MyTimer1";
// Use Peripheral
PWM1.timer.$assign = "Timer3";
// Assign pin
PWM1.timer.pwmPin.$assign = "boosterpack.9"; // P01
// Name - The C/C++ identifier used in applications as the index parameter passed to UART runtime APIs
UART1.$name = "UART_CO2";
// Name
UART1.uart.$name = "MyUART1";
// Assign pin
UART1.uart.txPin.$assign = "boosterpack.15"; // P07
// Assign pin
UART1.uart.rxPin.$assign = "boosterpack.18"; // P08
// Name - The C/C++ identifier used in applications as the index parameter passed to Timer runtime APIs
Timer1.$name = "CONFIG_TIMER_0";
// Interrupt Priority - Timer Interrupt Priority
Timer1.interruptPriority = "1";
// Name
Timer1.timer.$name = "MyTimer1";
// Use Peripheral
Timer1.timer.$assign = "Timer0";
// Name - The C/C++ identifier used in applications as the index parameter passed to Timer runtime APIs
Timer2.$name = "Reading_Timer";
// Interrupt Priority - Timer Interrupt Priority
Timer2.interruptPriority = "2";
// Timer Type
Timer2.timerType = "32 Bits";
// Name
Timer2.timer.$name = "MyTimer1";
// Name - The C/C++ identifier used in applications as the index parameter passed to Capture runtime APIs
Capture1.$name = "TEMP_CAPTURE";
// Interrupt Priority - Hardware interrupt priority
Capture1.interruptPriority = "1";
// Name
Capture1.timer.$name = "MyTimer1";
// Assign pin
Capture1.timer.capturePin.$assign = "boosterpack.4"; // P03
// Mode - Select the GPIO mode
GPIO12.mode = "Dynamic";
// Name - The C/C++ identifier used in applications as the index parameter passed to GPIO runtime APIs
GPIO12.$name = "Temp_pin";
// Name - The C/C++ identifier used in applications as the index parameter passed to Crypto runtime APIs
Crypto1.$name = "CONFIG_Crypto_0";
// Suggest solution
UART1.uart.$suggestSolution = "UART1";
// Suggest solution
Timer2.timer.$suggestSolution = "Timer2";
// Suggest solution
Capture1.timer.$suggestSolution = "Timer1";
// Suggest solution
GPIO12.gpioPin.$suggestSolution = "5";
